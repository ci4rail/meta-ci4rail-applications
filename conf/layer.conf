## conf/layer.conf
```bitbake
# We have a conf and classes directory, add to BBPATH
BBPATH .= ":${LAYERDIR}"

# We have recipes-* directories, add to BBFILES
BBFILES += "${LAYERDIR}/recipes-*/*/*.bb \
            ${LAYERDIR}/recipes-*/*/*.bbappend"

BBFILE_COLLECTIONS += "meta-ci4rail-applications"
BBFILE_PATTERN_meta-ci4rail-applications = "^${LAYERDIR}/"
BBFILE_PRIORITY_meta-ci4rail-applications = "120"

LAYERSERIES_COMPAT_meta-ci4rail-applications = "dunfell"
LAYERDEPENDS_meta-ci4rail-applications = ""
```
